/********************************************************
 * @author  Airead Fan <fgh1987168@gmail.com>		*
 * @date    201110月 14 21:39:35 CST			*
 ********************************************************
 *		after studying C 88 days		*
 *		after studying APUE 53 days		*
 *		after studying ARM 6 days		*
 ********************************************************/

/*
 * This program is free software; you can redistribute it and/or modify
 * it under the terms of the GNU General Public License as published by
 * the Free Software Foundation; either version 2 of the License, or
 * (at your option) any later version.
 *
 * This program is distributed in the hope that it will be useful,
 * but WITHOUT ANY WARRANTY; without even the implied warranty of
 * MERCHANTABILITY or FITNESS FOR A PARTICULAR PURPOSE.  See the
 * GNU General Public License for more details.
 *
 * You should have received a copy of the GNU General Public License
 * along with this program; if not, write to the Free Software
 * Foundation, Inc., 59 Temple Place, Suite 330, Boston, MA  02111-1307  USA
 */

OUTPUT_FORMAT("elf32-littlearm", "elf32-littlearm", "elf32-littlearm")
OUTPUT_ARCH(arm)
ENTRY(_start)

SECTIONS
{
	/* BASE_ADDR will be replaced with definition in Makefile by cpp */
	. = BASE_ADDR;
	.reset : {
	       KEEP(*(.reset));
	}

	. = ALIGN(32);
	.text : {
	      KEEP(*(.text));
	}

	. = ALIGN(32);
	.rodata : {
		 KEEP(*(.rodata));
	}

	. = ALIGN(32);
	.data : { 
	      KEEP(*(.data));
	}

	. = ALIGN(32);
	_bin_end = .;

	. = ALIGN(32);

	.bss : { 
		_bss_start = .;
		KEEP(*(.bss*));
		_bss_end = .;
	}

	. = ALIGN(32);
	_heap_start = .;
}